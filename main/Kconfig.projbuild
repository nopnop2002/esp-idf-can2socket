## main/Kconfig.projbuild
```kconfig
menu "Application Configuration"

	config GPIO_RANGE_MAX
		int
		default 33 if IDF_TARGET_ESP32
		default 46 if IDF_TARGET_ESP32S2
		default 48 if IDF_TARGET_ESP32S3
		default 19 if IDF_TARGET_ESP32C3
		default 30 if IDF_TARGET_ESP32C6

	menu "CAN Setting"

		choice CAN_BITRATE
			prompt "CAN Bitrate"
			default CAN_BITRATE_500
			help
				Select the CAN bitrate for the example.
			config CAN_BITRATE_25
				bool "BITRATE_25"
				help
					CAN bitrate is 25 Kbit/s.
			config CAN_BITRATE_50
				bool "BITRATE_50"
				help
					CAN bitrate is 50 Kbit/s.
			config CAN_BITRATE_100
				bool "BITRATE_100"
				help
					CAN bitrate is 100 Kbit/s.
			config CAN_BITRATE_125
				bool "BITRATE_125"
				help
					CAN bitrate is 125 Kbit/s.
			config CAN_BITRATE_250
				bool "BITRATE_250"
				help
					CAN bitrate is 250 Kbit/s.
			config CAN_BITRATE_500
				bool "BITRATE_500"
				help
					CAN bitrate is 500 Kbit/s.
			config CAN_BITRATE_800
				bool "BITRATE_800"
				help
					CAN bitrate is 800 Kbit/s.
			config CAN_BITRATE_1000
				bool "BITRATE_1000"
				help
					CAN bitrate is 1 Mbit/s.
		endchoice

		config CTX_GPIO
			int "CTX GPIO number"
			range 0 GPIO_RANGE_MAX
			default 21 if IDF_TARGET_ESP32
			default 17 if IDF_TARGET_ESP32S2 || IDF_TARGET_ESP32S3
			default  0 # C3 and others
			help
				GPIO number (IOxx) to CTX.
				Some GPIOs are used for other purposes (flash connections, etc.).
				GPIOs 35-39 are input-only so cannot be used as outputs.

		config CRX_GPIO
			int "CRX GPIO number"
			range 0 GPIO_RANGE_MAX
			default 22 if IDF_TARGET_ESP32
			default 18 if IDF_TARGET_ESP32S2 || IDF_TARGET_ESP32S3
			default  1 # C3 and others
			help
				GPIO number (IOxx) to CRX.
				Some GPIOs are used for other purposes (flash connections, etc.).
				GPIOs 35-39 are input-only so cannot be used as outputs.

		config ENABLE_PRINT
			bool "Output the received CAN FRAME to STDOUT"
			default n
			help
				Output the received CAN FRAME to STDOUT.

	endmenu

	menu "WiFi Setting"

		config ESP_WIFI_SSID
			string "WiFi SSID"
			default "myssid"
			help
				SSID (network name) to connect to.

		config ESP_WIFI_PASSWORD
			string "WiFi Password"
			default "mypassword"
			help
				WiFi password (WPA or WPA2) to connect to.

		config ESP_MAXIMUM_RETRY
			int "Maximum retry"
			default 5
			help
				Set the Maximum retry to avoid station reconnecting to the AP unlimited when the AP is really inexistent.

	endmenu

	menu "Socket Setting"

		choice FORMAT
			bool "Select Display Format"
			default FORMAT_TEXT
			help
				Select Display Format.
			config FORMAT_TEXT
				bool "Display Format is plane text"
			config FORMAT_JSON
				bool "Display Format is JSON"
			config FORMAT_XML
				bool "Display Format is XML"
			config FORMAT_CSV
				bool "Display Format is CSV"
		endchoice

		choice PROTOCOL
			bool "Select Protocol"
			default PROTOCOL_TCP
			help
				Select Socket Protocol.
			config PROTOCOL_TCP
				bool "Use TCP Protocol"
			config PROTOCOL_UDP
				bool "Use UDP Protocol"
		endchoice

		config TCP_HOST
			depends on PROTOCOL_TCP
			string "TCP Host"
			default "your_tcp_server"
			help
				The remote host to connect to this IPV4 address.

		config TCP_PORT
			depends on PROTOCOL_TCP
			int "TCP Port"
			range 0 65535
			default 8080
			help
				The remote port to which the client will connect to.

		choice UDP_ADDRESS
			depends on PROTOCOL_UDP
			bool "Select UDP Addrss"
			default UDP_LIMITED_BROADCAST
			help
				Select Send Addrss.
			config UDP_LIMITED_BROADCAST
				bool "Limited broadcast address"
			config UDP_DIRECTED_BROADCAST
				bool "Directed broadcast address"
			config UDP_MULTICAST
				bool "Multicast address"
			config UDP_UNICAST
				bool "Unicast address"
		endchoice

		config UDP_MULTICAST_ADDRESS
			depends on UDP_MULTICAST
			string "Multicast address"
			default "239.255.255.255"

		config UDP_UNICAST_ADDRESS
			depends on UDP_UNICAST
			string "Unicast address"
			default "192.168.10.20"

		config UDP_PORT
			depends on PROTOCOL_UDP
			int "UDP Port"
			range 0 65535
			default 8080
			help
				The remote port to which the client will connect to.

	endmenu

endmenu
```
